## configs/linux-5.10-arm64_withO0_defconfig
```kconfig
CONFIG_MAIN_PROJ_NAME="linux-5.10-arm64_withO0_defconfig"
CONFIG_ARM64=y
CONFIG_ARCH_MAGIC="3"
CONFIG_COMMON_UTILISE=y
CONFIG_PK_BUSYBOX=y
CONFIG_BUSYBOX_WGET=y
CONFIG_BUSYBOX_VERSION="1.35.0"
CONFIG_BUSYBOX_SRC=3
CONFIG_PK_QEMU_SYSTEM=y
CONFIG_QEMU_SYSTEM_WGET=y
CONFIG_QEMU_SYSTEM_VERSION="5.0.0"
CONFIG_QEMU_SYSTEM_SRC=3
CONFIG_ROOTFS=y
CONFIG_FS_EXT4=y
CONFIG_ROOTFS_SIZE=4096
CONFIG_TOOLCHAIN=y
CONFIG_AARCH64_VERSION="v10.3-2021.07"
CONFIG_JAGUAR_TOOL_AARCH64=y
CONFIG_JAGUAR_TOOL_AARCH64_DL=y
CONFIG_JAGUAR_TOOL_AARCH64_SRC=1
CONFIG_JAGUAR_TOOL_AARCH64_DL_NAME="gcc-arm-10.3-2021.07-x86_64-aarch64-none-linux-gnu.tar.xz"
CONFIG_LINUX_KERNEL=y
CONFIG_LINUX_NEWEST=y
CONFIG_LINUX_KERNEL_VERSION="5.10.0"
CONFIG_LINUX_BUILD_HIST="Newest"
CONFIG_LINUX_KERNEL_SRC_JAGUAR=y
CONFIG_LINUX_KERNEL_GITHUB=y
CONFIG_LINUX_KERNEL_GITHUB_SITE="ssh://git@bit.jaguarmicro.com:7999/~shawn.shao/linux-kernel-5.10-compile-with-o0.git"
CONFIG_LINUX_KERNEL_SRC=1
LINUX_KERNEL_SRC_JAGUAR=y
CONFIG_LINUX_KERNEL_TAR_TYPE="tar.xz"
CONFIG_LINUX_KERNEL_CROSS_COMPILE= "aarch64-none-linux-gnu"
```

## toolchain/aarch64-none-linux-gnu/Kconfig
```kconfig
menuconfig TOOL_AARCH64
	bool "aarch64-none-linux-gnu"

if TOOL_AARCH64

choice
	prompt "Setup way to get aarch64-none-linux-gnu"

config TOOL_AARCH64_DL
	bool "aarch64-none-linux-gnu from external file"

config TOOL_AARCH64_WGET
	bool "aarch64-none-linux-gnu from wget"

endchoice

config TOOL_AARCH64_SRC
	int
	default 1 if TOOL_AARCH64_DL
	default 2 if TOOL_AARCH64_WGET

if TOOL_AARCH64_WGET

choice 
	prompt "Release version"

config AARCH64_V10.3-2021.07
	bool "v10.3-2021.07"
	
endchoice

config AARCH64_FULL_NAME
	string
	default "10.3-2021.07/binrel/gcc-arm-10.3-2021.07-x86_64-aarch64-none-linux-gnu.tar.xz" if AARCH64_V10.3-2021.07

config AARCH64_VERSION
	string
	default "v10.3-2021.07" if AARCH64_V10.3-2021.07
 
endif # TOOL_AARCH64_WGET

if TOOL_AARCH64_DL

config TOOL_AARCH64_DL_NAME
	string "aarch64-none-linux-gnu absolute path"

config AARCH64_VERSION
	string "aarch64-none-linux-gnu version"
	default "v10.3-2021.07"

endif # TOOL_AARCH64_DL

endif # TOOL_AARCH64
```
